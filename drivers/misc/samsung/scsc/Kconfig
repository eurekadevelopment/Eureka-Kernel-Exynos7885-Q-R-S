## drivers/misc/samsung/scsc/Kconfig
```kconfig
config SCSC_CORE_CM
	tristate "Samsung SCSC Maxwell driver Core Module"
	depends on SCSC_CORE

config SCSC_CORE
	tristate "Samsung SCSC Maxwell driver"
	select SCSC_CORE_CM

config SCSC_CORE_FW_LOCATION
	string "SCSC FW location"
	default "/system/etc/wifi"
	---help---
	  Select the FW location, when CONFIG_SCSC_CORE_FW_LOCATION_AUTO=n

config SCSC_CORE_FW_LOCATION_AUTO
	string "SCSC FW location auto select"
	default y
	---help---
	  Select the FW location (Android N/O) automatically

config SCSC_CORE_TOOL_LOCATION
	string "SCSC tool location"
	default "/system/bin"
	---help---
	  Select the moredump tool location, when CONFIG_SCSC_CORE_FW_LOCATION_AUTO=n

config SCSC_WLBT_CONFIG_PLATFORM
	string "SCSC WLBT PLATFORM"
	default ""
	---help---
	  Select the platform, e.g. lassen_smdk

config SCSC_PCIE
	tristate "Samsung SCSC MIF PCIE implementation"
	depends on SCSC_CORE
	depends on PCI
config SCSC_MXLOGGER
	bool "Samsung SCSC MXLOGGER (Sable)"
	depends on SCSC_CORE
	default n
	---help---
	   MXLOGGER provides FW level logging in DRAM


config SCSC_WLBTD
	bool "Samsung SCSC Daemon support for Android O"
	depends on SCSC_CORE
	default n
	---help---
	   Uses generic netlink messages to communicate events to userspace daemon which takes necessary actions e.g. taking moredump

config SCSC_WRITE_INFO_FILE_WLBTD
	bool "SCSC flag to decide whether to write file via wlbtd or not"
	depends on SCSC_WLBTD
	default y
	---help---
		SCSC flag to decide whether to write file via wlbtd or not

config SCSC_PLATFORM
	tristate "Samsung SCSC MIF Platform driver implementation"
	depends on SCSC_CORE

config SCSC_CM_MX_CLIENT_TEST
	tristate "Samsung SCSC Test Client"
	depends on SCSC_CORE

config SCSC_MX_ALWAYS_ON
	tristate "Samsung SCSC MX140 always booted"
	depends on SCSC_CM_MX_CLIENT_TEST

config SCSC_CLK20MHZ
	tristate "Samsung SCSC USB 20MHz Clock"
	depends on SCSC_CORE

config SCSC_CLK20MHZ_TEST
	tristate "Samsung SCSC USB 20MHz Clock Test"
	depends on SCSC_CLK20MHZ

config SCSC_MMAP
	tristate "Samsung SCSC MMAP/GDB User space interface"
	depends on SCSC_CORE

config SCSC_DBG_SAMPLER
	tristate "Samsung SCSC Debug Sampler Service"
	depends on SCSC_CORE

config SCSC_DEBUG
	tristate "Samsung SCSC Logging"
	depends on SCSC_CORE && DEBUG_FS
	default n

config SCSC_DEBUG_COMPATIBILITY
	bool "Samsung SCSC Logging mode"
	depends on SCSC_DEBUG
	default n

config SCSC_STATIC_RING
	tristate "Samsung SCSC Logging use static ring"
	depends on SCSC_DEBUG
	default n

config SCSC_STATIC_RING_SIZE
	int "Size of the static ring"
	depends on SCSC_STATIC_RING
	default "1048576"
	range 1024 16777216

config SCSC_CHV_SUPPORT
	bool "Samsung CHV f/w support"
	depends on SCSC_CORE
	default n

config SCSC_GPR4_CON_DEBUG
	bool "GPR4 PIO muxes switching to the Maxwell Subsystem"
	depends on SCSC_PLATFORM
	default n

config SCSC_BUILD_TYPE
       string "Type of Kernel Build"
       ---help---
         Type of Kernel Build: User, User Debug, Engineering

config SCSC_WIFILOGGER
	tristate "Samsung SCSC Android Wi-Fi Logger"
	depends on SCSC_CORE
	default n

config SCSC_WIFILOGGER_DEBUGFS
	bool "Samsung SCSC Android Wi-Fi Logger DebugFS"
	depends on SCSC_WIFILOGGER && DEBUG_FS
	default y

config SCSC_WIFILOGGER_TEST
	bool "Samsung SCSC Android Wi-Fi Logger Test Harness"
	depends on SCSC_WIFILOGGER && SCSC_WIFILOGGER_DEBUGFS
	default n

config SCSC_LOG_COLLECTION
	bool "Samsung SCSC Log Collection"
	depends on SCSC_CORE
	default n
	---help---
	  Enable LOG collection to collect Chunks (host and FW) and generate a SBL file

config SCSC_MX150_EXT_DUAL_FEM
	bool "Support MX150 boards with dual external WLBT front-end"
	default n
	---help---
	Some boards have dual-external front end module for WLAN/BT
	which is controlled via GPIO. Enable driver support for this.
	Note that the customer board-specific DTS file also needs
	patching for this to work.
```

## drivers/misc/samsung/scsc_bt/Kconfig
```kconfig
config SCSC_BT
        tristate "SCSC MX BT support"
        depends on SCSC_CORE

config SCSC_BT_BLUEZ
	default N
        tristate "SCSC MX BlueZ support"
        depends on SCSC_CORE

config SCSC_ANT
	default N
        tristate "SCSC MX ANT support"
        depends on SCSC_CORE
	---help---
	  This module adds support for using a ANT character device.
```

## drivers/misc/usim_det/Kconfig
```kconfig
#
# USIM_DETECT Device Driver
#

config USIM_DETECT
	bool "USIM_DETECT Support"
	default n
	help
		This enables USIM_DETECT driver to control USIM detection pins
```

## drivers/motor/Kconfig
```kconfig
	  
config MOTOR_ZH915
	tristate "motor"
	default n
	help
	  Say Y to enable MOTOR ZH915.

config SEC_VIB
	tristate "SEC DC Vibrator"
	default n
	help
		If you say yes here you will get support for the
		SEC DC Vibrator.

config MOTOR_S2MU004
	tristate "s2mu004 haptic driver"
	default n
	depends on I2C
	help
	 Say Y to include support for S.LSI S2MU004 Haptic driver.
	
config MOTOR_S2MU106
	tristate "s2mu106 haptic driver"
	default n
	depends on I2C
	help
	 Say Y to include support for System LSI s2mu106
	 Haptic driver.
	 The Haptic Motor driver support both ERM and
	 LRA type actuators.


config ISA1000
	tristate "IMAGIS ISA1000"
	default n
	depends on ANDROID_TIMED_OUTPUT
	help
		If you say yes here you will get support for the
		haptic driver of IMAGIS ISA1000.

config MOTOR_VOLTAGE_3P3
	bool "Using MOTOR VOLTAGE 3P3"
	depends on MOTOR_S2MU106
	default n
	help
		If you say yes here you will get support for
		for the  MOTOR VOLTAGE 3P3 feature.
```

## drivers/muic/Kconfig
```kconfig
#
# MUIC devices
#

comment "MUIC configs"

config USE_MUIC
	bool "Using MUIC device driver"
	depends on I2C
	default n
	help
	  If you say yes here you will get support for
	  the MUIC device driver.

config USE_SAFEOUT
	bool "Using SAFEOUT device driver"
	depends on I2C
	default n
	help
	  If you say yes here you will get support for
	  the SAFEOUT device driver.

config MUIC_NOTIFIER
	bool "MUIC notifier support"
	depends on USE_MUIC
	default n
	help
	  If you say yes here you will get support for
	  the MUIC attached device status change notification.

config MUIC_MANAGER
	bool "MUIC Manager supports CCIC chip interface"
	depends on USE_MUIC
	default n
	help
	  If you say yes here you will get support manager for the CCIC chip.

config MUIC_CORE
	bool "Supports MUIC Core"
	depends on USE_MUIC
	default n
	help
	  If you say yes here you will get support for the MUIC Core functionalities

config MUIC_HV
	bool "MUIC_HV"
	depends on USE_MUIC
	default n
	help
	  If you say yes here you will get support for the AFC.

config MUIC_HV_12V
	bool "MUIC_HV_12V"
	depends on MUIC_HV
	default n
	help
	  If you say yes here you will get support for the AFC.

config MUIC_SUPPORT_CCIC
	bool "MUIC supports CCIC chip interface"
	depends on USE_MUIC
	default n
	help
	  If you say yes here you will get support for the CCIC chip.

config MUIC_SUPPORT_POWERMETER
	bool "MUIC supports PM chip interface"
	depends on USE_MUIC
	default n
	help
	  If you say yes here you will get support for the Power Meter.

config MUIC_S2MU004
	bool "Using S2MU004 MUIC"
	depends on USE_MUIC && MFD_S2MU004
	default n
	help
	  If you say yes here you will get support for the S2MU004 MUIC chip.

config MUIC_SUPPORT_CCIC_OTG_CTRL
	bool "MUIC Allows CCIC to Disable MUIC VBUS DET"
	depends on USE_MUIC
	default n
	help
	  If you say yes here you will get support for this.

config MUIC_SUPPORT_TYPEB
	bool "Using Type-B Features"
	depends on USE_MUIC
	default n
	help
	  If you say yes here you will get support for the TypeB Features.

config MUIC_SYSFS
	bool "Using muic sysfs Features"
	depends on USE_MUIC
	default n
	help
	  If you say yes here you will get support for the muic sysfs.

config MUIC_SUPPORT_VBUS_BOOST
	bool "Using muic Features for vbus boost"
	depends on USE_MUIC && BATTERY_SAMSUNG_V2
	default n
	help
	  If you say yes here you will get support for the muic vbus boosting.

config HV_MUIC_S2MU004_AFC
	bool "Using S2MU004 MUIC AFC"
	depends on MUIC_S2MU004
	default n
	help
	  If you say yes here you will get support for the AFC.

config HV_MUIC_VOLTAGE_CTRL
	bool "Using AFC Voltage control functionality"
	depends on MUIC_HV_S2MU004_AFC || MUIC_HV
	default n
	help
	  If you say yes here you will get support for
	  the AFC voltage control functionality.

config MUIC_S2MU004_AFC_DISABLE
	bool "Using AFC disable functionality"
	depends on MUIC_S2MU004
	default n
	help
	  If you say yes here you will get support for
	  the AFC disable control functionality.

config S2MU004_NONE_WATERPROOF_MODEL
	bool "Supporting S2MU004 Type-C NONE_WATERPROOF_MODEL"
	depends on MUIC_S2MU004
	default n
	help
	  If you say yes here you will get support for
	  the S2MU004 Type-C NONE_WATERPROOF_MODEL functions.

config MUIC_S2MU005
	bool "Using S2MU005 MUIC"
	depends on USE_MUIC && MFD_S2MU005
	default n
	help
	  If you say yes here you will get support for
	  for the S2MU005 MUIC chip.

config MUIC_S2MU005_ENABLE_AUTOSW
	bool "Using S2MU005 MUIC ENABLE AUTOSW"
	depends on MUIC_S2MU005
	default n
	help
	  If you say yes here you will get support for
	  for the S2MU005 MUIC chip ENABLE AUTOSW feature.

config MUIC_S2MU005_DISCHARGING_WA
	bool "Using S2MU005 MUIC DISCHARGING WORKAROUND"
	depends on MUIC_S2MU005
	default n
	help
		If you say yes here you will get support for
		for the S2MU005 MUIC chip DISCHARGING WA feature.

config MUIC_S2MU106
	bool "Using S2MU106 MUIC"
	depends on USE_MUIC && MFD_S2MU106
	default n
	help
	  If you say yes here you will get support for the S2MU106 MUIC chip.

config HV_MUIC_S2MU106_AFC
	bool "Using S2MU106 MUIC AFC"
	depends on MUIC_HV && MUIC_S2MU106
	default n
	help
	  If you say yes here you will get support for the AFC.

config MUIC_S2MU106_RID
	bool "Using S2MU106 MUIC RID"
	depends on MUIC_S2MU106
	default n
	help
	  If you say yes here you will get support for the S2MU106 MUIC RID functions.

config S2MU106_TYPEC_WATER
	bool "Using S2MU106 Type-C Water Detection"
	depends on MUIC_S2MU106_RID
	default n
	help
	  If you say yes here you will get support for
	  the S2MU106 Type-C Water functions.

config S2MU106_IFCONN_HOUSE_NOT_GND
	bool "take w/a when ifconn house is not gnd"
	depends on S2MU106_TYPEC_WATER
	default n
	help
	  If you say yes here you will get support w/a for
	  the ifconn house is not gnd models.

config MUIC_S2MU106_FAST_DETECTION
	bool "Using S2MU106 Type-C Water Detection, fast cable also."
	depends on S2MU106_TYPEC_WATER
	default n
	help
	  If you say yes here you will get support for
	  the S2MU106 Type-C Water Fast Cable detect functions.

config MUIC_S2MU205
	bool "Using S2MU205 MUIC"
	depends on USE_MUIC && MFD_S2MU205
	default n
	help
	  If you say yes here you will get support for the S2MU205 MUIC chip.

config MUIC_S2MU205_RID
	bool "Using S2MU205 MUIC RID"
	depends on MUIC_S2MU205
	default n
	help
	  If you say yes here you will get support for the S2MU205 MUIC RID functions.

config S2MU205_TYPEC_WATER
	bool "Using S2MU205 Type-C Water Detection"
	depends on MUIC_S2MU205_RID
	default n
	help
	  If you say yes here you will get support for
	  the S2MU205 Type-C Water functions.

config NONE_WATERPROOF_MODEL
	bool "Supporting Type-C NONE_WATERPROOF_MODEL"
	depends on USE_MUIC
	default n
	help
	  If you say yes here you will get support for
	  the Type-C NONE_WATERPROOF_MODEL functions.

config HICCUP_CHARGER
	bool "Using HICCUP charger"
	depends on USE_MUIC
	default n
	help
		If you say yes here you will get support for
		for the hiccup charger feature.
config CP_UART_SWITCH
	bool "Using CP UART PATH"
	depends on USE_MUIC
	default n
	help
		If you say yes here you will get support for
		for the cp uart path feature.

config NEW_FACTORY_JIGONB
	bool "Using JIGONB control"
	depends on USE_MUIC
	default n
	help
		If you say yes here you will get support for
		for the jigonb control.

config NEW_FACTORY_UART
	bool "Using factory uart control"
	depends on USE_MUIC
	default n
	help
		If you say yes here you will get support for
		for the factory uart control.

config MUIC_INCOMPATIBLE_VZW
	bool "Using Verizon incomatible type"
	depends on USE_MUIC
	default n
	help
		If you say yes here you will get support for
		for the Verizon incomatible type cable.

config MUIC_S2MU005_SUPPORT_HMT
	bool "Using HMT"
	depends on USE_MUIC
	default n
	help
		If you say yes here you will get support for
		for the HMT accessory.

config MUIC_UNIVERSAL
	bool "UNIVERSAL MUIC"
	depends on USE_MUIC
	default n
	help
	  If you say yes here you will get support for various MUIC chips.

config MUIC_UNIVERSAL_MAX77865
	bool "MAX77865 MUIC"
	depends on MUIC_UNIVERSAL
	default n
	help
	  If you say yes here you will get support for the MAX77865 MUIC chip.

config MUIC_HV_MAX77865
	bool "MUIC_HV_MAX77865"
	depends on MUIC_UNIVERSAL_MAX77865
	default n
	help
	  If you say yes here you will get support for the AFC.

config MUIC_S2MU004_NON_USB_C_TYPE
	bool "Using S2MU005 MUIC with non usb-c type"
	depends on MUIC_S2MU004
	default n
	help
	  If you say yes here you will get support for
	  for the S2MU004 MUIC non usb-c type chip.

config MUIC_TEST_FUNC
	bool "MUIC supports several function's in TEST"
	depends on SEC_DEBUG && !SAMSUNG_PRODUCT_SHIP
	default n
	help
	  If you say yes here you will get support for the TEST function's.

config TYPEB_WATERPROOF_MODEL
	bool "Using TYPEB WATERPROOF MODEL"
	depends on USE_MUIC
	default n
	help
		If you say yes here you will get support for
		for the  TYPEB WATERPROOF MODEL feature.

config MUIC_SUPPORT_PRSWAP
	bool "MUIC supports power role swap"
	depends on USE_MUIC
	default n
	help
	  If you say yes here you will get support for the power role swap.

config MUIC_NOT_SUPPORT_QC
	bool "MUIC not supports quick charger"
	depends on MUIC_HV
	default n
	help
	  If you say yes here you will not get support for the quick charger.
```
