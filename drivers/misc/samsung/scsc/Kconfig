## drivers/sensorhub/stm32/factory/Magnetic/Kconfig
```kconfig
#
# sensor drivers configuration
#

config SENSORS_SSP_MAGNETIC_AK09918C
	tristate "Sensors ssp magnetic sensor ak09918c"
	default n
	depends on SPI
	help
	  magnetic sensor ak09918c file for factory test in ssp driver.
          If you say yes here you get magnetic sensor ak09918c support for
	  factory test.
	  To compile this driver as a module, choose M here: the
	  module will be called ssp.

config SENSORS_SSP_MAGNETIC_AK09916C
	tristate "Sensors ssp magnetic sensor ak09916c"
	default n
	depends on SPI
	help
	  magnetic sensor ak09916c file for factory test in ssp driver.
          If you say yes here you get magnetic sensor ak09916c support for
	  factory test.
	  To compile this driver as a module, choose M here: the
	  module will be called ssp.

config SENSORS_SSP_MAGNETIC_AK09911
	tristate "Sensors ssp magnetic sensor ak09911"
	default n
	depends on SPI
	help
	  magnetic sensor ak09911 file for factory test in ssp driver.
          If you say yes here you get magnetic sensor ak09911 support for
	  factory test.
	  To compile this driver as a module, choose M here: the
	  module will be called ssp.

config SENSORS_SSP_MAGNETIC_LSM303AH
	tristate "Sensors ssp magnetic sensor lsm303ah"
	default n
	depends on SPI
	help
	  magnetic sensor lsm303ah file for factory test in ssp driver.
          If you say yes here you get magnetic sensor lsm303ah support for
	  factory test.
	  To compile this driver as a module, choose M here: the
	  module will be called ssp.

config SENSORS_SSP_MAGNETIC_YAS539
	tristate "Sensors ssp magnetic sensor yas539"
	default n
	depends on SPI
	help
	  magnetic sensor yas539 file for factory test in ssp driver.
          If you say yes here you get magnetic sensor yas539 support for
	  factory test.
	  To compile this driver as a module, choose M here: the
	  module will be called ssp.
```

## drivers/sensorhub/stm_v2/Kconfig
```kconfig
#
# sensor drivers configuration
#

config SENSORS_SSP
	tristate "Sensors ssp"
	default n
	depends on SPI
	help
	  ssp driver for sensor hub.
          If you say yes here you get ssp support for
	  sensor hub.
	  To compile this driver as a module, choose M here: the
	  module will be called ssp.

config SENSORS_SSP_STM32
	tristate "Sensors ssp stm32f410"
	default n
	depends on SPI
	help
	  ssp driver for sensor hub.
          If you say yes here you get ssp support for
	  sensor hub.
	  To compile this driver as a module, choose M here: the
	  module will be called ssp.


config SSP_ENG_DEBUG
	tristate "sensor hub eng debug mode"
	default n	
	help	  
	  If you want to use eng debug mode for sensor hub, it should be set.

config SENSORS_A96T3X6
	depends on I2C
	tristate "A96T3X6 touchkey"
	default n
	help
	  Say Y here if you use A96T3X6 for grip.
	  This option enables grip sensors using
	  Above A96T3X6 device driver for grip.

	  Say N here if you do not use A96T3X6 for grip.

source "drivers/sensorhub/stm_v2/factory/Kconfig"
```

## drivers/sensorhub/stm_v2/factory/Barometer/Kconfig
```kconfig
#
# sensor drivers configuration
#

config SENSORS_SSP_BAROMETER_LPS22H
	tristate "Sensors ssp barometer lps22h"
	default n
	depends on SPI
	help
	  barometer lps22h file for factory test in ssp driver.
          If you say yes here you get barometer lps22h support for
	  factory test.
	  To compile this driver as a module, choose M here: the
	  module will be called ssp.

config SENSORS_SSP_BAROMETER_LPS25H
	tristate "Sensors ssp barometer lps25h"
	default n
	depends on SPI
	help
	  barometer lps25h file for factory test in ssp driver.
          If you say yes here you get barometer lps25h support for
	  factory test.
	  To compile this driver as a module, choose M here: the
	  module will be called ssp.

config SENSORS_SSP_BAROMETER_BMP280
	tristate "Sensors ssp barometer bmp280"
	default n
	depends on SPI
	help
	  barometer bmp280 file for factory test in ssp driver.
          If you say yes here you get barometer bmp280 support for
	  factory test.
	  To compile this driver as a module, choose M here: the
	  module will be called ssp.
```

## drivers/sensorhub/stm_v2/factory/Gyroscope/Kconfig
```kconfig
#
# sensor drivers configuration
#

config SENSORS_SSP_GYROSCOPE_LSM6DSL
	tristate "Sensors ssp gyroscope sensor lsm6dsl"
	default n
	depends on SPI
	help
	  gyroscope sensor lsm6dsl file for factory test in ssp driver.
          If you say yes here you get gyroscope sensor lsm6dsl support for
	  factory test.
	  To compile this driver as a module, choose M here: the
	  module will be called ssp.

config SENSORS_SSP_GYROSCOPE_K6DS3TR
	tristate "Sensors ssp gyroscope sensor k6ds3tr"
	default n
	depends on SPI
	help
	  gyroscope sensor k6ds3tr file for factory test in ssp driver.
          If you say yes here you get gyroscope sensor k6ds3tr support for
	  factory test.
	  To compile this driver as a module, choose M here: the
	  module will be called ssp.

config SENSORS_SSP_GYROSCOPE_MPU6500
	tristate "Sensors ssp gyroscope sensor mpu6500"
	default n
	depends on SPI
	help
	  gyroscope sensor mpu6500 file for factory test in ssp driver.
          If you say yes here you get gyroscope sensor mpu6500 support for
	  factory test.
	  To compile this driver as a module, choose M here: the
	  module will be called ssp.

config SENSORS_SSP_GYROSCOPE_BMI168
	tristate "Sensors ssp gyroscope sensor bmi168"
	default n
	depends on SPI
	help
	  gyroscope sensor bmi168 file for factory test in ssp driver.
          If you say yes here you get gyroscope sensor bmi168 support for
	  factory test.
	  To compile this driver as a module, choose M here: the
	  module will be called ssp.
```

## drivers/sensorhub/stm_v2/factory/Light/Kconfig
```kconfig
#
# sensor drivers configuration
#

config SENSORS_SSP_LIGHT_TMG399X
	tristate "Sensors ssp light tmg399x"
	default n
	depends on SPI
	help
	  light tmg399x file for factory test in ssp driver.
          If you say yes here you get light tmg399x support for
	  factory test.
	  To compile this driver as a module, choose M here: the
	  module will be called ssp.

config SENSORS_SSP_LIGHT_TMD3725
	tristate "Sensors ssp light tmd3725"
	default n
	depends on SPI
	help
	  light tmd3725 file for factory test in ssp driver.
          If you say yes here you get light tmd3725 support for
	  factory test.
	  To compile this driver as a module, choose M here: the
	  module will be called ssp.

config SENSORS_SSP_LIGHT_TMD3700
	tristate "Sensors ssp light tmd3700"
	default n
	depends on SPI
	help
	  light tmd3700 file for factory test in ssp driver.
          If you say yes here you get light tmd3700 support for
	  factory test.
	  To compile this driver as a module, choose M here: the
	  module will be called ssp.
```

## drivers/sensorhub/stm_v2/factory/Proximity/Kconfig
```kconfig
#
# sensor drivers configuration
#

config SENSORS_SSP_PROXIMITY_AUTO_CAL_TMD3725
	tristate "Sensors ssp proximity auto cal tmd3725"
	default n
	depends on SPI
	help
	  proximity tmd3725 file for factory test in ssp driver.
          If you say yes here you get proximity tmd3725 support for
	  factory test.
	  To compile this driver as a module, choose M here: the
	  module will be called ssp.

config SENSORS_SSP_PROXIMITY_TMG399X
	tristate "Sensors ssp proximity tmg399x"
	default n
	depends on SPI
	help
	  proximity tmg399x file for factory test in ssp driver.
          If you say yes here you get proximity tmg399x support for
	  factory test.
	  To compile this driver as a module, choose M here: the
	  module will be called ssp.

config SENSORS_SSP_PROXIMITY_TMD3700
	tristate "Sensors ssp proximity tmd3700"
	default n
	depends on SPI
	help
	  proximity tmd3700 file for factory test in ssp driver.
          If you say yes here you get proximity tmd3700 support for
	  factory test.
	  To compile this driver as a module, choose M here: the
	  module will be called ssp.

config SENSORS_SSP_PROXIMITY_TMD3725
	tristate "Sensors ssp proximity tmd3725"
	default n
	depends on SPI
	help
	  proximity tmd3725 file for factory test in ssp driver.
          If you say yes here you get proximity tmd3725 support for
	  factory test.
	  To compile this driver as a module, choose M here: the
	  module will be called ssp.
```
