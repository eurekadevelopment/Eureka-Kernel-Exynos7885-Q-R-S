## drivers/net/wireless/scsc/Kconfig
```kconfig
config SCSC_WLAN
	tristate "Driver for Samsung SCSC Maxwell Wifi"
	depends on SCSC_CORE
	depends on CFG80211

if SCSC_WLAN != n
config SCSC_WLAN_KEY_MGMT_OFFLOAD
        bool "Enable roam offload for SCSC WLAN"
        default y
        ---help---
          This option enables roam offload for SCSC WLAN.

config SCSC_WLAN_HIP4_PROFILING
	bool "Enable HIP4 profiling"
	depends on SCSC_WLAN
	---help---
	  This option enables HIP4 profiling

config SCSC_WLAN_DEBUG
	bool "Enable debug output from the SCSC Wifi driver"
	depends on SCSC_WLAN
	select SCSC_WLAN_HIP4_PROFILING
	---help---
	  This option enables debug support for the SCSC wifi chipset.

config SCSC_WLAN_SG
	bool "Enable SCSC WLAN Scatter-gather and GSO support"
	depends on SCSC_WLAN
        default y
	---help---
	  This option enables scatter-gather and GSO feature

config SCSC_WLAN_SKB_TRACKING
	bool "Enable debug memory tracking of skb data in the driver"
	---help---
	  This option enables tracking of all skb data in the driver..
	  This will affect the performance!

config SCSC_WLAN_OFFLINE_TRACE
	bool "Enable event logging buffer"
	---help---
	  The wifi driver has support for event logging in a circular
	  buffer. With the various trace enabled, the buffer is
	  continually updated with logging information. The buffer
	  can be dumped by writing to the proc file
	  (/proc/driver/unifi0/hip2dbgdumptrigger).

config SCSC_WLAN_OFFLINE_TX_TRACE
	depends on SCSC_WLAN_OFFLINE_TRACE
	bool "Enable transmit trace logging"
	---help---
	  This option enables logging of transmit events
	  to the buffer. This option is useful when tracing
	  a transmission event from top to bottom.

config SCSC_WLAN_OFFLINE_DATA_PLANE_PROFILE_TRACE
	depends on SCSC_WLAN_OFFLINE_TRACE
	bool "Enable extra information to the SDIO command logging"
	---help---
	  This options creates additional information for the
	  SDIO trace.

config SCSC_WLAN_RX_NAPI
	bool "Enable use of net device napi rx polling api"
	---help---
	  This option enables the drivers use of the napi api

config SCSC_WLAN_RX_NAPI_GRO
	bool "Enable use of net device napi rx GRO"
	depends on SCSC_WLAN_RX_NAPI
	---help---
	  This option enables the drivers use of the napi Generic Receive Offload

config SCSC_WLAN_PSCHED_AMSDU
	bool "Enable transmit A-MSDU creation"
	default y
	---help---
	  The driver packet scheduler can create A-MSDU frames
	  from frames in the same TID queue for transmission.d

config SCSC_WLAN_ANDROID
	bool "Android specific support"
	default y
	---help---
	  Enable support for Android specific aspects of the driver.

config SCSC_WLAN_STA_ONLY
	bool "Support WLAN STA only (no P2P/AP/IBSS)"
	default n
	---help---
	  Enable only basic STA mode for debugging purposes

config SCSC_WLAN_HIP_SUPPORT_SCATTER_GATHER_API
	bool "Enable scatter/gather IO for hip"
	default y
	---help---
	  Enable the support for SDIO scatter/gather APIs for hip transfers.

config SCSC_WLAN_KIC_OPS
	bool "Wi-Fi service driver provides OPS for KIC to use for various tasks"
	depends on SAMSUNG_KIC
	default y
	---help---
	  Provide Wi-Fi service driver OPS, which KIC can use for triggering Wi-Fi related events.

config SCSC_WLAN_GSCAN_ENABLE
	bool "Enable GSCAN in SCSC wlan driver"
	default y
	---help---
	  This option enables GSCAN in SCSC wlan driver.

config SCSC_WLAN_WES_NCHO
	bool "Enable NCHO/WES feature"
	default y
	---help---
	  This option enables the NCHO/WES feature

config SCSC_WLAN_MUTEX_DEBUG
	bool "Enable Mutex debugging mechanism in slsi wlan driver"
	default n
	---help---
	  This option enables the Mutex debug reports in slsi wlan driver.

config CONFIG_SCSC_WLAN_BLOCK_IPV6
	bool "Block IPv6"
	default n
	---help---
	  This option blocks IPv6 packets.

config CONFIG_SCSC_WLAN_DISABLE_NAT_KA
	bool "Disable NAT"
	default n
	---help---
	  This option disables NAT.

config SCSC_WLAN_HANG_TEST
	bool "Test HANG Event"
	default y
	---help---
	   This option facilitates triggering of HANG Event
	   to reset WLAN.

config SCSC_WLAN_NAT_KEEPALIVE_DISABLE
	bool "Disable NAT KeepAlive"
	default n
	---help---
	  This option disables the NAT KeepAlive
	  Offload Feature.

config SCSC_WLAN_ENHANCED_LOGGING
	bool "Enable Enhanced Logging"
	depends on SCSC_WIFILOGGER
	default y
	---help---
	  This option enables the Enhanced Logging
	  Feature.

config SCSC_WLAN_ACM_API
	bool "Provide TSF read API"
	default n
	---help---
	  This option provides API to read TSF.

endif

config SCSC_WLAN_MAC_ADDRESS_FILENAME
	string "MAC address filename"
	default "/efs/wifi/.mac.info"
	---help---
	  Select the programmed MAC address file.

config SCSC_WLAN_MAX_INTERFACES
        int "Max number of virtual interfaces supported"
        range 1 12
        default 3
        ---help---
          The driver structures are sized to support this
          number of interfaces.

config SCSC_WLAN_AP_INFO_FILE
        bool "Create .softap.info file"
        default n
        ---help---
          The option enables the driver to create .softap.info
          file in user space and fill information in it.

config SCSC_WLAN_WIFI_SHARING
	bool "Wifi Sharing Support"
	default y
	---help---
	  This option tells if wifi sharing is supported or not.

config SCSC_WLAN_SAE_CONFIG
        bool "Wpa3 Support"
        default n
        ---help---
          This option tells if wpa3  is supported or not.

config SCSC_WLAN_ENABLE_MAC_RANDOMISATION
        bool "Wifi Mac Randomization Support"
        default y
        ---help---
          This option tells if mac randomization is supported or not.

config SCSC_WLAN_SINGLE_ANTENNA
	depends on SCSC_WLAN_WIFI_SHARING
	bool "Single Antenna Supported"
	default y
	---help---
	  This option tells if there is support for single
	  antenna or dual antenna.

config SCSC_WLAN_ACS_ENABLE
        bool "ACS Support"
        default y
        ---help---
          This option tells if automatic channel selection is
	  supported or not.

config SCSC_AP_INTERFACE_NAME
        string "AP net device interface name"
        default "swlan0"
        ---help---
          AP net device interface name.

config SCSC_WLAN_MHS_STATIC_INTERFACE
        bool "Static AP Interface Support"
        default n
        ---help---
          This option tells if AP interface has been created
          statically or dynamically.

config SCSC_ENHANCED_PACKET_STATS
        bool "Enable enhanced packet stats"
        default n
        ---help---
          This option tells whether enhanced packet stats collection
          is enabled or not.

config SCSC_WIFI_NAN_ENABLE
        bool "Enable WiFi NAN"
        default n
        ---help---
          This option tells whether WiFi NAN is enabled or not.

config SCSC_WLAN_SET_NUM_ANTENNAS
        bool "Enable configuring of number of antennas"
        default n
        ---help---
          This option tells whether configuring of number of antennas is enabled or not.

config SCSC_WLAN_LOW_LATENCY_MODE
        bool "Support enabling/disabling roaming as per latency mode"
        default n
        ---help---
          This option tells whether support is provided for enabling
          or disabling roaming as per the latency mode.

config SCSC_WLAN_SET_PREFERRED_ANTENNA
        bool "Enable the driver to set preferred antenna"
        default n
        ---help---
          This option enables the driver to set the preferred antenna.

config SLSI_WLAN_STA_FWD_BEACON
        bool "Forwarding beacon support"
        default y
        ---help---
          This option tells if beacon forwarding in STA mode is enabled or not.
          When it is enabled, Driver deliver beacon info of connected AP to Supplicant.

config SCSC_WLAN_STA_ENHANCED_ARP_DETECT
        bool "Enable enhanced arp detection"
        default n
        ---help---
          This option tells whether enhanced arp detection
          is enabled or not.

config SCSC_WLAN_MAX_LINK_SPEED
        bool "Enable max link speed calculation"
        default n
        ---help---
        This option tells if max linkspeed calculation is enabled or not.

config SCSC_WLAN_DUAL_STATION
        bool "Enable dual station"
        default n
        ---help---
        This option tells if dual station feature is supported or not.

config SCSC_WLAN_BSS_SELECTION
        bool "Select AP if bssid is not present"
        default n
        ---help---
        This option enable the selection of AP based on the BSSID hint.
```

## drivers/nfc/Kconfig
```kconfig
#
# Near Field Communication (NFC) devices
#


config NFC_PN533
	tristate "NXP PN533 USB driver"
	depends on USB
	help
	  NXP PN533 USB driver.
	  This driver provides support for NFC NXP PN533 devices.

	  Say Y here to compile support for PN533 devices into the
	  kernel or say M to compile it as module (pn533).
	  
config NFC_PN547 
	bool "NXP PN547 Controller"
	default n
	help
	  NXP PN547 Near Field Communication controller support.
	  This option enables device driver support for the NFC.
	  It is used by many services. NFC is fully controlled using I2C
	  to communicate the AP chip.

config NFC_WILINK
	tristate "Texas Instruments NFC WiLink driver"
	depends on TI_ST && NFC_NCI
	help
	  This enables the NFC driver for Texas Instrument's BT/FM/GPS/NFC
	  combo devices. This makes use of shared transport line discipline
	  core driver to communicate with the NFC core of the combo chip.

	  Say Y here to compile support for Texas Instrument's NFC WiLink driver
	  into the kernel or say M to compile it as module.

config NFC_TRF7970A
	tristate "Texas Instruments TRF7970a NFC driver"
	depends on SPI && NFC_DIGITAL
	help
	  This option enables the NFC driver for Texas Instruments' TRF7970a
	  device. Such device supports 5 different protocols: ISO14443A,
	  ISO14443B, FeLiCa, ISO15693 and ISO18000-3.

	  Say Y here to compile support for TRF7970a into the kernel or
	  say M  to compile it as a module. The module will be called
	  trf7970a.ko.

config NFC_MEI_PHY
	tristate "MEI bus NFC device support"
	depends on INTEL_MEI && NFC_HCI
	help
	  This adds support to use an mei bus nfc device. Select this if you
	  will use an HCI NFC driver for an NFC chip connected behind an
	  Intel's Management Engine chip.

	  If unsure, say N.

config NFC_SIM
	tristate "NFC hardware simulator driver"
	help
	  This driver declares two virtual NFC devices supporting NFC-DEP
	  protocol. An LLCP connection can be established between them and
	  all packets sent from one device is sent back to the other, acting as
	  loopback devices.

	  If unsure, say N.

config NFC_PORT100
	tristate "Sony NFC Port-100 Series USB device support"
	depends on USB
	depends on NFC_DIGITAL
	help
	  This adds support for Sony Port-100 chip based USB devices such as the
	  RC-S380 dongle.

	  If unsure, say N.

config SAMSUNG_NFC
	bool "Samsung NFC driver"
	default n
	help
	  Say Y here if you want to build support for NFC (Near field
	  communication) devices.
	  To compile this support as a module, choose M here: the module will
	  be called nfc.

config ESE_P3_LSI
        bool "Oberthur ese driver"
        depends on SPI
        default n
        help
          Oberthur Driver.
          This driver provides support for LSI NXP combined ESE products.
          You should select your NFC product and interface.

config ESE_SECURE
        bool "ESE Secure Controller Driver"
        depends on !SEC_FACTORY
        default n
        help
          Common eSE Secure controller support.
          This option enables device driver support for the eSE with NFC.
          It is used by many services. eSE is fully controlled using SPI
          to communication

config ESE_SECURE_SPI_PORT
        int "ese spi port number"
        depends on ESE_SECURE 
        default 99

config ESE_SECURE_GPIO
        depends on ESE_SECURE
        string "gpio group for ese"

config SEC_NFC
        bool "Samsung NFC driver"
        default n
        help
          SAMSUNG NFC Driver.
          This driver provides support for SAMSUNG NFC products.
          You should select your NFC product and interface.

          Say Y here to compile support for SAMSUNG NFC driver into the
          kernel.

choice
        prompt "SEC NFC Products"
        depends on SEC_NFC
config SEC_NFC_PRODUCT_N5
        bool "N5"
endchoice
choice
        prompt "SEC NFC Interface"
        depends on SEC_NFC
config SEC_NFC_IF_I2C
        bool "I2C"
        depends on SEC_NFC_PRODUCT_N5
endchoice

source "drivers/nfc/fdp/Kconfig"
source "drivers/nfc/pn544/Kconfig"
source "drivers/nfc/microread/Kconfig"
source "drivers/nfc/nfcmrvl/Kconfig"
source "drivers/nfc/st21nfca/Kconfig"
source "drivers/nfc/st-nci/Kconfig"
source "drivers/nfc/nxp-nci/Kconfig"
source "drivers/nfc/s3fwrn5/Kconfig"
source "drivers/nfc/nfc_logger/Kconfig"
```

## drivers/sensorhub/stm32/Kconfig
```kconfig
#
# sensor drivers configuration
#

config SENSORS_SSP
	tristate "Sensors ssp"
	default n
	depends on SPI
	help
	  ssp driver for sensor hub.
          If you say yes here you get ssp support for
	  sensor hub.
	  To compile this driver as a module, choose M here: the
	  module will be called ssp.

config SENSORS_SSP_STM32
	tristate "Sensors ssp stm32f410"
	default n
	depends on SPI
	help
	  ssp driver for sensor hub.
          If you say yes here you get ssp support for
	  sensor hub.
	  To compile this driver as a module, choose M here: the
	  module will be called ssp.

config SENSORS_SSP_2017A3
	tristate "Sensors ssp 2017a3"
	default n
	depends on SPI
	help
	  ssp driver for sensor hub.
          If you say yes here you get ssp support for
	  sensor hub.
	  To compile this driver as a module, choose M here: the
	  module will be called ssp.

config SSP_REGISTER_RW
	tristate "SensorHub support Register RW"
	default n
	help
	  If you want to use Register RW sysfs, it should be set.

source "drivers/sensorhub/stm32/factory/Kconfig"
source "drivers/sensorhub/stm32/max_notchfilter/Kconfig"
```

## drivers/sensorhub/stm32/factory/Accelometer/Kconfig
```kconfig
#
# sensor drivers configuration
#

config SENSORS_SSP_ACCELOMETER_LSM6DSL
	tristate "Sensors ssp accelometer sensor lsm6dsl"
	default n
	depends on SPI
	help
	  accelerometer sensor lsm6dsl file for factory test in ssp driver.
          If you say yes here you get accelerometer sensor lsm6dsl support for
	  factory test.
	  To compile this driver as a module, choose M here: the
	  module will be called ssp.

config SENSORS_SSP_ACCELOMETER_K6DS3TR
	tristate "Sensors ssp accelometer sensor k6ds3tr"
	default n
	depends on SPI
	help
	  accelerometer sensor k6ds3tr file for factory test in ssp driver.
          If you say yes here you get accelerometer sensor k6ds3tr support for
	  factory test.
	  To compile this driver as a module, choose M here: the
	  module will be called ssp.

config SENSORS_SSP_ACCELOMETER_MPU6500
	tristate "Sensors ssp accelometer sensor mpu6500"
	default n
	depends on SPI
	help
	  accelerometer sensor mpu6500 file for factory test in ssp driver.
          If you say yes here you get accelerometer sensor mpu6500 support for
	  factory test.
	  To compile this driver as a module, choose M here: the
	  module will be called ssp.

config SENSORS_SSP_ACCELOMETER_BMI168
	tristate "Sensors ssp accelometer sensor bmi168"
	default n
	depends on SPI
	help
	  accelerometer sensor bmi168 file for factory test in ssp driver.
          If you say yes here you get accelerometer sensor bmi168 support for
	  factory test.
	  To compile this driver as a module, choose M here: the
	  module will be called ssp.
```
