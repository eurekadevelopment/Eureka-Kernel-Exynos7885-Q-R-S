## drivers/video/fbdev/exynos/dpu_7885/Kconfig
```kconfig
config EXYNOS_DECON_7885
	bool "Samsung Exynos7885 Display system (DPP, DECON, MIPI)"
	default y
	depends on FB

if EXYNOS_DECON_7885
config EXYNOS_DECON_FB
	bool "Samsung DECON Framebuffer driver"
	depends on EXYNOS_DECON_7885
	select MEDIA_EXYNOS
	default y
	help
	  Say Y here if you want support for the DECON in Samsung S5P SoCs.
	  This device produce image data to one of output interfaces.

config EXYNOS_DPP
	bool "Samsung Exynos Display Post Processor driver"
	depends on EXYNOS_DECON_7885
	default y

config EXYNOS_MIPI_DSIM
	bool "Samsung Exynos MIPI-DSI driver"
	depends on EXYNOS_DECON_7885
	default y
	help
	  Enable MIPI-DSI driver.

config EXYNOS_MIPI_DISPLAYPORT
	bool "Samsung Exynos DISPLAYPORT driver"
	depends on EXYNOS_DECON_7885
	default n
	help
	  Enable DISPLAYPORT driver.

config EXYNOS_ZEBU_EMUL_DISP
	bool "Zebu Emulator Display driver"
	depends on EXYNOS_DECON_7885
	default y

config FB_WINDOW_UPDATE
        bool "DECON window update mode"
        depends on EXYNOS_DECON_7885
        default n

config DECON_BLOCKING_MODE
	bool "DECON blocking mode"
        depends on EXYNOS_DECON_7885
        default n

config DECON_EVENT_LOG
	bool "Display sub-system event logger (DECON/DSIM/DPP)"
        depends on DEBUG_INFO && EXYNOS_DECON_7885
        default y

config DECON_HIBER
	bool "DECON hiber mode"
        depends on EXYNOS_DECON_7885
        default n

config EXYNOS_DOZE
	bool "Suppot Doze mode to aod service"
	depends on EXYNOS_DECON_7885
	default n

config EXYNOS_SUPPORT_DOZE
	bool "Suppot backword compatibility for EXYNOS_DOZE"
	depends on EXYNOS_DOZE
	default y

config EXYNOS_SUPPORT_FB_HANDOVER
	bool "Suppot bootloader framebuffer handover"
	depends on EXYNOS_DECON_7885
	default y

config DPU_20
	bool "New fence operation and New header sync with HWC2.0"
	depends on EXYNOS_DECON_7885 && (ANDROID_VERSION >= 90000)
	default y if (ANDROID_VERSION >= 90000)

config LCD_HMT
	bool "Suppot video emul & aid reverse to VR"
	depends on EXYNOS_DECON_7885
	default n

config SUPPORT_MASK_LAYER
	bool "Support mask layer"
	depends on EXYNOS_DECON_LCD
	default y

config LOGGING_BIGDATA_BUG
	bool "Logging extra information when decon bug"
	depends on SEC_DEBUG
	default n

endif

source "drivers/video/fbdev/exynos/dpu_7885/panels/Kconfig"
```

## drivers/video/fbdev/exynos/dpu_7885/panels/Kconfig
```kconfig
config EXYNOS_DECON_LCD
	depends on EXYNOS_DECON_7885
	bool "Select LCD panel driver"

config EXYNOS_DECON_LCD_S6E3FA0
	depends on EXYNOS_DECON_LCD && EXYNOS_MIPI_DSIM
	tristate "S6E3FA0 AMOLED FHD LCD driver"

config EXYNOS_DECON_LCD_S6E3FA3
	depends on EXYNOS_DECON_LCD && EXYNOS_MIPI_DSIM
	tristate "S6E3FA3 AMOLED FHD LCD driver"

config EXYNOS_DECON_LCD_S6E3FA7
	depends on EXYNOS_DECON_LCD && EXYNOS_MIPI_DSIM
	tristate "S6E3FA7 AMOLED FHD+ LCD driver"

config DISPLAY_USE_INFO
	tristate "Support display use info logging"
	default n

config EXYNOS_DECON_MDNIE
	tristate "Support MDNIE"
	default n

config EXYNOS_DECON_MDNIE_LITE
	depends on EXYNOS_DECON_MDNIE
	tristate "Support backward compatibility for MDNIE"
	default y

config SUPPORT_POC_FLASH
	depends on EXYNOS_DECON_LCD
	tristate "Support display poc flash"
	default n

config EXYNOS_DECON_LCD_S6E3FA7_JACKPOT2
	tristate "S6E3FA7_JACKPOT2 LCD driver"

config EXYNOS_DECON_LCD_S6E3FA7_JACKPOT
	tristate "S6E3FA7_JACKPOT LCD driver"

config EXYNOS_DECON_LCD_TD4100_J3TOPE
	bool "TD4100_J3TOPE LCD driver"

config EXYNOS_DECON_LCD_S6D7AT0B_J7TOPE
	bool "S6D7AT0B_J7TOPE LCD driver"

config EXYNOS_DECON_LCD_EA8061S_J7DUO
	bool "EA8061S_J7DUO LCD driver"

config EXYNOS_DECON_LCD_S6E8AA5_A6ELTE
	bool "S6E8AA5_A6ELTE LCD driver"

config EXYNOS_DECON_LCD_S6E8AA5_FEEL2
	bool "S6E8AA5_FEEL2 LCD driver"

config EXYNOS_DECON_LCD_SN65DSI86_GVIEW2
	bool "SN65DSI86_HX8876_VIEW2 LCD driver"

config EXYNOS_DECON_LCD_S6E3FA7_A7Y18
	tristate "S6E3FA7_A7Y18 LCD driver"

config EXYNOS_DECON_LCD_TD4101_J2COREPELTE
	bool "TD4101_J2COREPELTE LCD driver"

config EXYNOS_DECON_LCD_HX8279D_GTA3XLLTE
	bool "HX8279D_GTA3XLLTE LCD driver"

config EXYNOS_DECON_LCD_HX83112A_M20
	bool "HX83112A_M20 LCD driver"

config EXYNOS_DECON_LCD_EA8076_M30
	bool "EA8076_M30 LCD driver"

config EXYNOS_DECON_LCD_EA8076_A30
	bool "EA8076_A30 LCD driver"

config EXYNOS_DECON_LCD_HX8279D_WISDOM
	bool "HX8279D_WISDOM LCD driver"

config EXYNOS_DECON_LCD_S6E8FC0_A20
	bool "S6E8FC0_A20 LCD driver"

config EXYNOS_DECON_LCD_S6E8FC0_A40
	bool "S6E8FC0_A40 LCD driver"

config EXYNOS_DECON_LCD_S6D7AT0B_A10
	bool "S6D7AT0B_A10 LCD driver"

config EXYNOS_DECON_LCD_HX83102D_A10E
	bool "HX83102D_A10E LCD driver"

config EXYNOS_DECON_LCD_HX83102D_A20E
	bool "HX83102D_A20E LCD driver"

config EXYNOS_DECON_LCD_S6D7AA0_XCOVER4S
	bool "S6D7AA0_XCOVER4S LCD driver"

config EXYNOS_DECON_LCD_S6E8FC0_A30C
	bool "S6E8FC0_A30C LCD driver"

config EXYNOS_DECON_LCD_S6E8FC1_A30S
	bool "S6E8FC1_A30S LCD driver"

config EXYNOS_DECON_LCD_HX83102D_A10E_JPN
	bool "HX83102D_A10E JPN LCD driver"

config EXYNOS_DECON_LCD_HX83102P_GTA4S
	bool "HX83102P_GTA4S LCD driver"
```

## sound/soc/samsung/abox/Kconfig
```kconfig
config SND_SOC_SAMSUNG_ABOX
	tristate "ASoC support for Samsung ABOX Audio"
	select REGMAP_MMIO
	select SND_SOC_COMPRESS
	help
	  Say Y or M if you want to add support for codecs attached to
	  the Samsung SoC ABOX interface. You will also need to
	  select the audio interfaces to support below.

config SEC_SND_SYNCHRONIZED_IPC
	tristate "Samsung ABOX Synchronized IPC for Audio"
	depends on SND_SOC_SAMSUNG_ABOX
	help
	  Say Y or M if you want to add support for external devices attached to
	  the Samsung SoC ABOX interface. You will also need to
	  select the audio interfaces to support below.

config SEC_SND_ADAPTATION
	tristate "Samsung ABOX Adaptation for Audio"
	depends on SND_SOC_SAMSUNG_ABOX
	help
	  Say Y or M if you want to add support for external devices attached to
	  the Samsung SoC ABOX interface. You will also need to
	  select the audio interfaces to support below.

config SND_SOC_BT_SHARED_SRATE
	tristate "Getting BT Shared Sampling Rate for AOSP Audio"
	help
	  Say Y or N if you want to add support for getting BT shared sampling rate to
	  the Samsung SoC(AOSP) ABOX interface. You will also need to
	  select the audio interfaces to support below.

config SND_SOC_FM
	tristate "Getting FM status for AUDPLL on/off"
	help
	  Say Y or N if you want to add support for getting FM status to
	  the Samsung SoC ABOX interface . You will also need to
	  select the audio interfaces to support below.
```
