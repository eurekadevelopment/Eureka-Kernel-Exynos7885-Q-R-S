## arch/arm64/Kconfig.exynos
```kconfig
config MACH_EXYNOS7885_A10_OPEN
	bool "Build Dtbo image for SM-A105"
	depends on SOC_EXYNOS7885
	default n
	help
	Say Y here if you want to enable building dtbo for Galaxy A10.

config MACH_EXYNOS7885_A20_GLOBAL
	bool "Build Dtbo image for SM-A205"
	depends on SOC_EXYNOS7885
	default n
	help
	Say Y here if you want to enable building dtbo for galaxy A20.

config MACH_EXYNOS7885_A20e_OPEN
	bool "Build Dtbo image for SM-A202"
	depends on SOC_EXYNOS7885
	default n
	help
	Say Y here if you want to enable building dtbo for Galaxy A20e.

config MACH_EXYNOS7885_A20e_KOR
	bool "Build Dtbo image for SM-A202K"
	depends on SOC_EXYNOS7885
	default n
	help
	Say Y here if you want to enable building dtbo for Galaxy A20e Korean varient, has DMB support.

config MACH_EXYNOS7885_A30_OPEN
	bool "Build Dtbo image for SM-A305"
	depends on SOC_EXYNOS7885
	default n
	help
	Say Y here if you want to enable building dtbo for Galaxy A30.

config MACH_EXYNOS7885_A30s_OPEN
	bool "Build Dtbo image for SM-A307"
	depends on SOC_EXYNOS7885
	default n
	help
	Say Y here if you want to enable building dtbo for Galaxy A30s.

config MACH_EXYNOS7885_A40_OPEN
	bool "Build Dtbo image for SM-A405"
	depends on SOC_EXYNOS7885
	default n
	help
	Say Y here if you want to enable building dtbo for Galaxy A40.

config MACH_EXYNOS7885_M20_OPEN
	bool "Build Dtbo image for SM-M205"
	depends on SOC_EXYNOS7885
	default n
	help
	Say Y here if you want to enable building dtbo for Galaxy M20.
```
