## drivers/bts/Kconfig
```kconfig
#
# BTS driver configuration
#

menuconfig EXYNOS_BTS
	bool "BTS driver support"
	default y
	help
	  Enable BTS (Bus traffic shaper) support

if EXYNOS_BTS

config EXYNOS7885_BTS
	bool "Bus traffic shaper support"
	default y
	depends on SOC_EXYNOS7885
	help
	  Enable BTS (Bus traffic shaper) support

config EXYNOS7885_BTS_VM
	bool "Bus traffic shaper support"
	default n
	depends on SOC_EXYNOS7885
	help
	  Enable BTS (Bus traffic shaper) support

config EXYNOS7872_BTS
	bool "Bus traffic shaper support"
	default y
	depends on SOC_EXYNOS7872
	help
	  Enable BTS (Bus traffic shaper) support

config EXYNOS8890_BTS
	bool "Bus traffic shaper support"
	default y
	depends on SOC_EXYNOS8890
	help
	  Enable BTS (Bus traffic shaper) support

config EXYNOS8890_BTS_OPTIMIZATION
	bool "Bus traffic shaper optimization mode"
	default n
	depends on EXYNOS8890_BTS
	help
	  Enable BTS (Bus traffic shaper) optimized set

config EXYNOS8895_BTS
	bool "Bus traffic shaper support"
	default y
	depends on SOC_EXYNOS8895
	help
	  Enable BTS (Bus traffic shaper) support
endif
```

## drivers/ccic/Kconfig
```kconfig
#
# USB PD driver
#

comment "USB PD configs"

config USE_CCIC
	bool "Using USBPD device driver"
	depends on I2C
	default n
	help
	  If you say yes here you will get support for
	  the USB PD(Power Delivery) device driver.

config CCIC_S2MU004
	bool "Using S2MU004 USB PD"
	depends on USE_CCIC
	default n
	help
	  If you say yes here you will get support for
	  for the S2MU004 USBPD chip.

config CCIC_S2MU106
	bool "Using S2MU106 USB PD"
	depends on USE_CCIC
	default n
	help
	  If you say yes here you will get support for
	  for the S2MU106 USBPD chip.

config CCIC_MANUAL_QBAT
	bool "Using S2MU106 USB PD QBAT Manual Control"
	depends on USE_CCIC
	default n
	help
	  If you say yes here you will get support for
	  for the S2MU106 USBPD chip.

config CCIC_S2MU205
	bool "Using S2MU205 USB PD"
	depends on USE_CCIC
	default n
	help
	  If you say yes here you will get support for
	  for the S2MU205 USBPD chip.

config CCIC_MODE_BY_MUIC
	bool "Using CCIC operate mode by MUIC RID"
	depends on USE_CCIC
	default n
	help
	  If you say yes here you will get support for
	  MUIC to control ccic DRP Mode

config CCIC_MODE_WITHOUT_MUIC
	bool "Using CCIC operate mode without MUIC RID"
	depends on USE_CCIC
	default n
	help
	  If you say yes here ccic always operate drp without MUIC

config CCIC_VDM
	bool "Using S2MU004 USB PD VDM Message"
	depends on USE_CCIC
	default n
	help
	  If you say yes here you will get support for
	  for the S2MU004 USBPD chip.

config CCIC_S2MM005 
	bool "CCIC S2MM005"
	depends on I2C 
	default n
	help
	  If you say yes here you will get support for
	  s2mm005 ccic full version chipset 
	  
config CCIC_NOTIFIER
	bool "CCIC notifier support"
	depends on I2C
	default n
	help
	  If you say yes here you will get support for
	  the CCIC attached device status change notification.

config CCIC_ALTERNATE_MODE 
	bool "support CCIC alternate mode"
	depends on I2C
	default n
	help
	  If you say yes here you will get support for
	  alternate mode

config CCIC_LPM_ENABLE
	bool "Support LPM ENABLE"
	depends on CCIC_S2MM005
	default n
	help
	  If you say yes here you will get support for
	  lpm enable

config CCIC_WATER_DETECT
	bool "support WATER DETECT"
	depends on CCIC_S2MM005
	default n
	help
	  If you say yes here you will get support for
	  water detect Enable

config CCIC_EXTERNAL_CAPACITOR
	bool "support WATER DETECT tuning for ext cc cap"
	depends on USE_CCIC
	default n
	help
	  If you say yes here you will get support for
	  water detect tuning for external cc capacitor.

config CCIC_TYPEC_PRSWAP
	bool "support Power Role Swap"
	depends on USE_CCIC
	depends on CCIC_S2MU004 || CCIC_S2MU106 || CCIC_S2MU205
	depends on ANDROID_MAJOR_VERSION != "n"
	depends on ANDROID_MAJOR_VERSION != "o"
	depends on ANDROID_MAJOR_VERSION != "p"
	default y
```

## drivers/eureka/Kconfig
```kconfig
menu "Eureka Extra Drivers"

config EUREKA_SYSFS
	bool
	default y
	help
	 Say Y here to get /sys/class/eureka sysfs
	 
config EUREKA_VERSION
	bool
	default y
	depends on EUREKA_SYSFS
	help
	 Say Y here to get kernel build infos, such as KBuild Host, KBuild User, Compilers,
	 etc. It will be on /sys/class/eureka/version
	 
endmenu
```

## drivers/gpu/arm/Kconfig
```kconfig
#
# (C) COPYRIGHT 2012-2013 ARM Limited. All rights reserved.
#
# This program is free software and is provided to you under the terms of the
# GNU General Public License version 2 as published by the Free Software
# Foundation, and any use by you of this program is subject to the terms
# of such GNU licence.
#
# A copy of the licence is included with the program, and can also be obtained
# from Free Software Foundation, Inc., 51 Franklin Street, Fifth Floor,
# Boston, MA  02110-1301, USA.
#

menu "ARM GPU Configuration"

config DDK_VERSION_OS
        string "version"
        default ANDROID_MAJOR_VERSION
        help
          Android OS major version

config MALI_TMIX
        tristate "Mali-TMIX support"
        default n
        help
          Enable this option to build support for the ARM Mali-G71 GPU.

          To compile this driver as a module, choose M here:
          this will generate a single module, called mali_kbase.

choice
        prompt "Version Configuration"
        depends on MALI_TMIX
        default MALI_TMIX_R26P0 if ANDROID_VERSION >= "110000"
        help
          Select the gpu support version.

config MALI_TMIX_R26P0
        depends on MALI_TMIX
        bool "mimir r26p0 driver"
endchoice

if MALI_TMIX_R26P0
source "drivers/gpu/arm/b_r26p0/Kconfig"
endif

endmenu
```

## drivers/gpu/arm/tMIx/r2p0/platform/exynos/Kconfig
```kconfig
#
# (C) COPYRIGHT 2012 ARM Limited. All rights reserved.
#
# This program is free software and is provided to you under the terms of the
# GNU General Public License version 2 as published by the Free Software
# Foundation, and any use by you of this program is subject to the terms
# of such GNU licence.
#
# A copy of the licence is included with the program, and can also be obtained
# from Free Software Foundation, Inc., 51 Franklin Street, Fifth Floor,
# Boston, MA  02110-1301, USA.
#
#




# Add your platform specific Kconfig file here
#
# "drivers/gpu/arm/.../platform/Kconfig"
#
# Where xxx is the platform name is the name set in MALI_PLATFORM_THIRDPARTY_NAME
#

config MALI_PLATFORM_THIRDPARTY
	depends on MALI_TMIX
	bool "Third Party Platform"
    default y
      help
      Select the SOC platform that contains a Mali

config MALI_PLATFORM_THIRDPARTY_NAME
	depends on MALI_PLATFORM_THIRDPARTY
	string "Third party platform name"
	help
	  Enter the name of a third party platform that is supported. The third part configuration
	  file must be in midgard/config/tpip/mali_kbase_config_xxx.c where xxx is the name
	  specified here.

config EXYNOS_SOC_NAME
    depends on MALI_PLATFORM_THIRDPARTY
    string "Third party soc name"
    help
      soc name.

config MALI_DVFS
    bool "Enable EXYNOS DVFS"
    depends on MALI_PLATFORM_THIRDPARTY
    default y
    help
      Choose this option to enable DVFS in the Mali Midgard DDK.

config MALI_PM_QOS
    bool "Enable DVFS with QoS"
    depends on MALI_PLATFORM_THIRDPARTY && MALI_DVFS && PM_DEVFREQ && CPU_FREQ
    default n
    help
      Choose this option to enable PM_QOS in the Mali tMIX DDK.

config MALI_BTS_OPTIMIZATION
    bool "Enable GPU BTS"
    depends on MALI_PLATFORM_THIRDPARTY && MALI_DVFS
    default n
    help
      Choose this option to enable BTS in the Mali tMIX DDK.

config MALI_RT_PM
    bool "Enable EXYNOS Runtime power management"
    depends on MALI_PLATFORM_THIRDPARTY && MALI_TMIX
    depends on PM
    default y
    help
      Choose this option to enable runtime power management in the Mali Midgard DDK.

config MALI_EXYNOS_TRACE
    bool "Enable EXYNOS kbase tracing"
    depends on MALI_PLATFORM_THIRDPARTY && MALI_TMIX
    default n
    help
      Enables tracing in kbase.  Trace log available through
      the "mali_trace" debugfs file, when the CONFIG_DEBUG_FS is enabled

config MALI_EXYNOS_TRACE_ALL
	bool "Enable EXYNOS kbase tracing with Mali Trace"
	depends on MALI_TMIX
	depends on MALI_EXYNOS_TRACE
	default n
	help
	  Change tracing level in kbase. Trace log available through
	  the "mali_trace" debugfs file, when the CONFIG_DEBUG_FS is enabled


#MALI_SEC_HWCNT is only used for Istor
#config MALI_SEC_HWCNT
#	bool "Enable sec hwcnt feature"
#	depends on MALI_PLATFORM_THIRDPARTY
#	default n
#	help
#	  Enable sec hwcnt feature.

config MALI_EXYNOS_SECURE_RENDERING
       bool "Exynos Secure Rendering Support"
       depends on MALI_PLATFORM_THIRDPARTY && ION_EXYNOS && EXYNOS_CONTENT_PATH_PROTECTION
       default n
       help
               Support Secure Rendering with Exynos SoC

config MALI_GPU_CORE_MASK_SELECTION
	bool "GPU core mask selection for Mali"
	depends on MALI_PLATFORM_THIRDPARTY && !SOC_EXYNOS7872
	default y
	help
		Support gpu core mask selection for Mali.
		Using the gpu coremask selection.
```

## drivers/gpu/arm/tMIx/r3p0/platform/exynos/Kconfig
```kconfig
#
# (C) COPYRIGHT 2012 ARM Limited. All rights reserved.
#
# This program is free software and is provided to you under the terms of the
# GNU General Public License version 2 as published by the Free Software
# Foundation, and any use by you of this program is subject to the terms
# of such GNU licence.
#
# A copy of the licence is included with the program, and can also be obtained
# from Free Software Foundation, Inc., 51 Franklin Street, Fifth Floor,
# Boston, MA  02110-1301, USA.
#
#

# Add your platform specific Kconfig file here
#
# "drivers/gpu/arm/.../platform/Kconfig"
#
# Where xxx is the platform name is the name set in MALI_PLATFORM_THIRDPARTY && MALI_MIDGARD_NAME
#

config MALI_PLATFORM_THIRDPARTY
	depends on MALI_TMIX && MALI_MIDGARD
	bool "Third Party Platform"
    default y
      help
      Select the SOC platform that contains a Mali

config MALI_PLATFORM_THIRDPARTY_NAME
	depends on MALI_PLATFORM_THIRDPARTY
	string "Third party platform name"
	help
	  Enter the name of a third party platform that is supported. The third part configuration
	  file must be in midgard/config/tpip/mali_kbase_config_xxx.c where xxx is the name
	  specified here.

config EXYNOS_SOC_NAME
    depends on MALI_PLATFORM_THIRDPARTY
    string "Third party soc name"
    help
      soc name.

# { SRUK-MALI_SYSTRACE_SUPPORT
config MALI_SYSTRACE_SUPPORT
    bool "Enable Exynos systrace Debug support"
    depends on MALI_PLATFORM_THIRDPARTY
    default n
    help
      Enable systrace marker in kernel
# SRUK-MALI_SYSTRACE_SUPPORT }

config MALI_DVFS
    bool "Enable EXYNOS DVFS"
    depends on MALI_PLATFORM_THIRDPARTY
    default y
    help
      Choose this option to enable DVFS in the Mali Midgard DDK.

config MALI_PM_QOS
    bool "Enable DVFS with QoS"
    depends on MALI_PLATFORM_THIRDPARTY && MALI_DVFS && PM_DEVFREQ && CPU_FREQ
    default n
    help
      Choose this option to enable PM_QOS in the Mali tMIX DDK.

config MALI_BTS_OPTIMIZATION
    bool "Enable GPU BTS"
    depends on MALI_PLATFORM_THIRDPARTY && MALI_DVFS
    default n
    help
      Choose this option to enable BTS in the Mali tMIX DDK.

config MALI_RT_PM
    bool "Enable EXYNOS Runtime power management"
    depends on MALI_PLATFORM_THIRDPARTY && MALI_TMIX
    depends on PM
    default y
    help
      Choose this option to enable runtime power management in the Mali Midgard DDK.

config MALI_EXYNOS_TRACE
    bool "Enable EXYNOS kbase tracing"
    depends on MALI_PLATFORM_THIRDPARTY && MALI_TMIX
    default n
    help
      Enables tracing in kbase.  Trace log available through
      the "mali_trace" debugfs file, when the CONFIG_DEBUG_FS is enabled

config MALI_EXYNOS_TRACE_ALL
	bool "Enable EXYNOS kbase tracing with Mali Trace"
	depends on MALI_TMIX
	depends on MALI_EXYNOS_TRACE
	default n
	help
	  Change tracing level in kbase. Trace log available through
	  the "mali_trace" debugfs file, when the CONFIG_DEBUG_FS is enabled

config MALI_SEC_CL_BOOST
    bool "Enable EXYNOS cl booster"
    depends on MALI_PLATFORM_THIRDPARTY && MALI_TMIX
    default y
    help
      Enables open cl dvfs booster.

config MALI_SEC_UTILIZATION
    bool "Enable EXYNOS custom utilization"
    depends on MALI_PLATFORM_THIRDPARTY && MALI_TMIX
    default y
    help
      Enables exynos custom utilization.

#MALI_SEC_HWCNT is only used for Istor
#config MALI_SEC_HWCNT
#	bool "Enable SEC HWCNT feature"
#	depends on MALI_PLATFORM_THIRDPARTY
#	default n
#	help
#	  Enable sec hwcnt feature.

config MALI_EXYNOS_SECURE_RENDERING
    bool "Enable EXYNOS Secure Rendering Support"
    depends on MALI_PLATFORM_THIRDPARTY && MALI_TMIX && ION_EXYNOS && EXYNOS_CONTENT_PATH_PROTECTION
    default y
    help
      Support Secure Rendering on Exynos SoC

config MALI_GPU_CORE_MASK_SELECTION
	bool "GPU core mask selection for Mali"
	depends on MALI_PLATFORM_THIRDPARTY && !SOC_EXYNOS7872
	default n
	help
		Support gpu core mask selection for Mali.
		Using the gpu coremask selection.

config MALI_SEC_JOB_STATUS_CHECK
	bool "Enable GPU JOB & FENCE STATUS DUMP "
	depends on MALI_TMIX && MALI_RT_PM && MALI_DVFS
	default n
	help
		Choose this option to enable job & fence status dump feature in the Mali tMIX DDK.
```

## drivers/gud/Kconfig
```kconfig
#
# Mobicore Configuration
#

if SOC_EXYNOS8895
source "drivers/gud/gud-exynos8895/Kconfig"
endif

if SOC_EXYNOS7872
source "drivers/gud/gud-exynos7872/Kconfig"
endif
if SOC_EXYNOS7885
source "drivers/gud/gud-exynos7885/Kconfig"
endif
```

## drivers/input/touchscreen/imagis/ist4050/Kconfig
```kconfig
#
# Imagis IST40XX Touchscreen driver
#

config TOUCHSCREEN_IST4050
  tristate "IST4050 I2C Touchscreen"
	depends on I2C
	help
	  Say Y here if you have the Imagis IST4050 I2C touchscreen
	  connected to your system.
```

## drivers/input/touchscreen/melfas_mms400/Kconfig
```kconfig
#
# Kconfig for MELFAS MMS400 Touchscreen driver
#

if INPUT_TOUCHSCREEN

config TOUCHSCREEN_MELFAS_MMS438
        tristate "MELFAS MMS438 Touchscreen"
        depends on I2C
        help
          Say Y here if you have a MELFAS MMS438 touchscreen device in your system.

#          If unsure, say N.

#          To compile this driver as a module, choose M here: the module will be called mms_ts.

endif
```

## drivers/input/touchscreen/zinitix/Kconfig
```kconfig
#
# Zinitix Touchscreen driver configuration
#

config TOUCHSCREEN_ZINITIX_BT532
	bool "ZINITIX BT532 touchscreen driver"
	depends on I2C
	default n
	help
	  Say Y here if you have a ZINITIX BT532 touchscreen.
	  If unsure, say N.

config TOUCHSCREEN_ZINITIX_BT541C
	bool "ZINITIX BT541C touchscreen driver"
	depends on I2C
	default n
	help
	  Say Y here if you have a ZINITIX BT541C touchscreen.
	  If unsure, say N.

config TOUCHSCREEN_ZINITIX_ZT75XX
	bool "ZINITIX ZT75XX touchscreen driver"
	depends on I2C
	default n
	help
	  Say Y here if you have a ZINITIX ZT75XX touchscreen.
	  If unsure, say N.

config TOUCHSCREEN_ZINITIX_ZT75XX_TCLM
	bool "ZINITIX ZT75XX touchscreen driver"
	depends on I2C
	default n
	help
	  Say Y here if you have a ZINITIX ZT75XX touchscreen.
	  If unsure, say N.

config TOUCHSCREEN_ZINITIX_ZT75XX_O7
	bool "ZINITIX ZT75XX touchscreen driver for On7 turkey model"
	depends on TOUCHSCREEN_ZINITIX_ZT75XX
	default n
	help
	  Say Y here if you have a ZINITIX ZT75XX touchscreen.
	  If unsure, say N.

config TOUCHSCREEN_ZINITIX_ZT75XX_WISDOM
	bool "ZINITIX ZT75XX touchscreen driver for wisdom model"
	depends on I2C
	default n
	help
	  Say Y here if you have a ZINITIX ZT75XX touchscreen.
	  If unsure, say N.
```
