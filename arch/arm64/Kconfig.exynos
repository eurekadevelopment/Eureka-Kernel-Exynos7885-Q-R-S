## drivers/media/platform/exynos/Kconfig
```kconfig
#
# Exynos multimedia device drivers
#
config VIDEO_EXYNOS
        bool "Exynos Multimedia Devices"
        depends on ARCH_EXYNOS
        default y
        help
          This is a representative exynos multimedia device.

if VIDEO_EXYNOS
        source "drivers/media/platform/exynos/mdev/Kconfig"
        source "drivers/media/platform/exynos/g2d1shot/Kconfig"
        source "drivers/media/platform/exynos/scaler/Kconfig"
        source "drivers/media/platform/exynos/mfc/Kconfig"
        source "drivers/media/platform/exynos/smfc/Kconfig"
        source "drivers/media/platform/exynos/camera-pp/Kconfig"
endif

config VIDEO_EXYNOS_FIMC_IS2
        bool "Exynos FIMC-IS2 (Image Subsystem) driver"
        depends on VIDEO_EXYNOS
        select MEDIA_EXYNOS
        select EXYNOS_FIMC_IS
        default n
        help
          This is a v4l2 driver for exynos FIMC-IS device.

if VIDEO_EXYNOS_FIMC_IS2
        source "drivers/media/platform/exynos/fimc-is2/Kconfig"
endif

config VIDEO_EXYNOS_FIMC_LEGACY
        bool "Exynos FIMC-LEGACY (Image Subsystem) driver"
        depends on VIDEO_EXYNOS
        select MEDIA_EXYNOS
        select EXYNOS_FIMC_IS
        default n
        help
          This is a v4l2 driver for exynos FIMC-IS device.

if VIDEO_EXYNOS_FIMC_LEGACY
        source "drivers/media/platform/exynos/fimc-legacy/Kconfig"
endif

config MEDIA_EXYNOS
        bool
        depends on VIDEO_EXYNOS
        default y
        help
          Compile mdev to use exynos media device driver.
```

## drivers/media/platform/exynos/camera-pp/gdc/Kconfig
```kconfig
menuconfig VIDEO_EXYNOS_CAMREA_POSTPROCESS_GDC
	bool "EXYNOS CAMERA POSTPROCESS GDC Driver"
	depends on VIDEO_EXYNOS_CAMREA_POSTPROCESS
	default y
	help
	  This is a representative exynos CAMERA-PP GDC device.

config CAMERA_PP_GDC_V1_0_0_OBJ
	bool "use GDC v1.0"
	depends on VIDEO_EXYNOS_CAMREA_POSTPROCESS_GDC
	default n
	help
		Use to build v1.0 driver

config CAMERA_PP_GDC_V1_1_0_OBJ
	bool "use GDC v1.1"
	depends on VIDEO_EXYNOS_CAMREA_POSTPROCESS_GDC
	default n
	help
		Use to build v1.0 driver
```

## drivers/media/platform/exynos/fimc-is2/Kconfig
```kconfig
source "drivers/media/platform/exynos/fimc-is2/ischain/Kconfig"
source "drivers/media/platform/exynos/fimc-is2/sensor/Kconfig"

#menu depth1
menu "Base Feature Setting"
	depends on EXYNOS_FIMC_IS

source "drivers/media/platform/exynos/fimc-is2/hardware/Kconfig"
endmenu

source "drivers/media/platform/exynos/fimc-is2/vendor/Kconfig"
```

## drivers/media/platform/exynos/fimc-is2/ischain/fimc-is-v6_20_0/Kconfig
```kconfig
config FIMC_IS_V6_20_0
	bool "Use fimc-is v6.20.0"
	depends on SOC_EXYNOS7885
	select EXYNOS_DEVICE_MIPI_CSIS_VER2 if !USE_SENSOR_GROUP
	select EXYNOS_DEVICE_MIPI_CSIS_VER3 if USE_SENSOR_GROUP
	select CSIS_V5_0
	select CAMERA_CIS_SELECT
	select CAMERA_ACT_SELECT
	select CAMERA_FLASH_SELECT
	select USE_DIRECT_IS_CONTROL
	select CAMERA_MC_SCALER_VER2_USE
	select CAMERA_TDNR_VER2_USE
	select MC_SCALER_V4_20
	select USE_HW_API_COMMON
	help
	  fimc-is version 6.20.0
```

## drivers/media/platform/exynos/fimc-is2/sensor/module_framework/iris/Kconfig
```kconfig
config CAMERA_IRIS_AK7372_OBJ
        bool "Use iris AK7372"
	depends on USE_DIRECT_IS_CONTROL
        default n
        help
          Use to build AK7372 driver.
```

## drivers/media/platform/exynos/fimc-is2/vendor/mcd_v2/Kconfig
```kconfig
config SENSOR_RETENTION_USE
        bool "Use sensor retention"
        depends on VENDER_MCD_V2
        default n
        help
          Use sensor retention.
config OIS_USE
        bool "Use ois"
        depends on VENDER_MCD_V2
        default n
        help
          Use ois.
config OIS_FW_UPDATE_THREAD_USE
        bool "Enable ois fw update thread"
        depends on OIS_USE
        default n
        help
          Enable ois fw update thread.
config AF_HOST_CONTROL
        bool "Enable host af control"
        depends on VENDER_MCD_V2
        default n
        help
          Enable host af control.
config FIMC_IS_DDK_DATA_LOAD
        bool "Enable signed binary processing."
        depends on VENDER_MCD_V2
        default n
        help
          Enable signed binary processing.
config TORCH_CURRENT_CHANGE_SUPPORT
        bool "Change torch current in recording mode"
        depends on VENDER_MCD_V2
        default n
        help
          Change torch current in recording mode.
config OIS_USE_RUMBA_S4
        bool "Use RUMBA S4 ois driver IC"
        depends on OIS_USE
        default n
        help
          Use RUMBA S4 ois driver IC.
config CAMERA_WXS_V00
        bool "This camera is wxs_v00 project"
        depends on VENDER_MCD_V2
        default n
        help
          This camera is wxs_v00 project.
config CAMERA_ATS_V03
        bool "This camera is ats_v03 project"
        depends on VENDER_MCD_V2
        default n
        help
          This camera is ats_v03 project.
config CAMERA_ATS_V04
        bool "This camera is ats_v04 project"
        depends on VENDER_MCD_V2
        default n
        help
          This camera is ats_v04 project.
config CAMERA_AAS_V30
        bool "This camera is aas_v30 project"
        depends on VENDER_MCD_V2
        default n
        help
          This camera is aas_v30 project.
config CAMERA_AAS_V40
        bool "This camera is aas_v40 project"
        depends on VENDER_MCD_V2
        default n
        help
          This camera is aas_v40 project.
config CAMERA_AAS_V20
        bool "This camera is aas_v20 project"
        depends on VENDER_MCD_V2
        default n
        help
          This camera is aas_v20 project.
config CAMERA_AAS_V30C
        bool "This camera is aas_v30c project"
        depends on VENDER_MCD_V2
        default n
        help
          This camera is aas_v30c project.
config CAMERA_AAS_V30S
        bool "This camera is aas_v30s project"
        depends on VENDER_MCD_V2
        default n
        help
          This camera is aas_v30s project.
config CAMERA_AAS_V30J
        bool "This camera is aas_v30j project"
        depends on VENDER_MCD_V2
        default n
        help
          This camera is aas_v30j project.
config CAMERA_AAS_V10
        bool "This camera is aas_v10 project"
        depends on VENDER_MCD_V2
        default n
        help
          This camera is aas_v10 project.
config CAMERA_AAS_V20E
        bool "This camera is aas_v20e project"
        depends on VENDER_MCD_V2
        default n
        help
          This camera is aas_v20e project.
config CAMERA_AAS_V10E
        bool "This camera is aas_v10e project"
        depends on VENDER_MCD_V2
        default n
        help
          This camera is aas_v10e project.
config CAMERA_AAS_V10EKX
        bool "This camera is aas_v10ekx project"
        depends on VENDER_MCD_V2
        default n
        help
          This camera is aas_v10ekx project.
config CAMERA_XXS_V04S
        bool "This camera is xxs_v04s project"
        depends on VENDER_MCD_V2
        default n
        help
          This camera is xxs_v04s project.
config CAMERA_AAS_V07J
        bool "This camera is aas_v07j project"
        depends on VENDER_MCD_V2
        default n
        help
          This camera is aas_v07j project.
config CAMERA_MMS_V20
        bool "This camera is mms_v20 project"
        depends on VENDER_MCD_V2
        default n
        help
          This camera is mms_v20 project.
config CAMERA_MMS_V10S
        bool "This camera is mms_v10s project"
        depends on VENDER_MCD_V2
        default n
        help
          This camera is mms_v10s project.
config CAMERA_USE_OTP_DPC_DATA
        bool "Use otp dpc data"
        depends on VENDER_MCD_V2
        default n
        help
          Use otp dpc data.
```

## drivers/media/platform/exynos/fimc-legacy/Kconfig
```kconfig
source "drivers/media/platform/exynos/fimc-legacy/ischain/Kconfig"
source "drivers/media/platform/exynos/fimc-legacy/sensor/Kconfig"

#menu depth1
menu "Base Feature Setting"
	depends on EXYNOS_FIMC_IS

source "drivers/media/platform/exynos/fimc-legacy/hardware/Kconfig"
endmenu

source "drivers/media/platform/exynos/fimc-legacy/vendor/Kconfig"
```

## drivers/media/platform/exynos/fimc-legacy/ischain/fimc-is-v4_0_0/Kconfig
```kconfig
config FIMC_IS_V4_0_0_LEGACY
	bool "Use fimc-is v4.0.0 legacy"
	depends on SOC_EXYNOS7420
	help
	  fimc-is version 4.0.0
```

## drivers/media/platform/exynos/fimc-legacy/vendor/Kconfig
```kconfig
menu "Vendor Feature Setting"
	depends on EXYNOS_FIMC_IS

choice
	prompt "Use vender features"
	depends on EXYNOS_FIMC_IS
	default VENDER_DEFAULT_LEGACY
	help
	  Use the vender specific features.

config VENDER_DEFAULT_LEGACY
        bool "Default"
config VENDER_MCD_LEGACY
        bool "MCD"
config VENDER_PSV_LEGACY
        bool "PSV"
endchoice

source "drivers/media/platform/exynos/fimc-legacy/vendor/psv/Kconfig"
source "drivers/media/platform/exynos/fimc-legacy/vendor/mcd/Kconfig"
endmenu
```

## drivers/media/platform/exynos/fimc-legacy/vendor/mcd/Kconfig
```kconfig
config CAMERA_EEPROM_SUPPORT_REAR
        bool "Enable eeprom for rear cam"
        depends on VENDER_MCD_LEGACY
        default n
        help
          Enable eeprom for rear cam.
config CAMERA_EEPROM_SUPPORT_FRONT
        bool "Enable eeprom for front cam"
        depends on VENDER_MCD_LEGACY
        default n
        help
          Enable eeprom for front cam
config CAMERA_EEPROM_SUPPORT_REAR2
        bool "Enable eeprom for 2ndrear cam"
        depends on VENDER_MCD_LEGACY
        default n
        help
          Enable EEPROM for 2nd rear cam in UV camera.
config CAMERA_EEPROM_SUPPORT_REAR3
        bool "Enable eeprom for 3rdrear cam"
        depends on VENDER_MCD_LEGACY
        default n
        help
          Enable EEPROM for 3rd rear cam in triple camera.
          This project has 3 rear camera and each camera has EEPROM for 1st one,
          OTPROM for 2nd one and EEPROM for 3rd camera.
          This option support EEPROM for 3rd rear camera.
config COMPANION_USE
        bool "Use companion"
        depends on VENDER_MCD_LEGACY
        default n
        help
          Use companion.
 config COMPANION_C1_USE
        bool "Use companion C1"
        depends on VENDER_MCD_LEGACY
        default n
        help
          Use companion C1.
 config COMPANION_C2_USE
        bool "Use companion C2"
        depends on VENDER_MCD_LEGACY
        default n
        help
          Use companion C2.
 config COMPANION_C3_USE
        bool "Use companion C3"
        depends on VENDER_MCD_LEGACY
        default n
        help
          Use companion C3.
 config COMPANION_DIRECT_USE
        bool "Use direct control for companion"
        depends on VENDER_MCD_LEGACY
        depends on COMPANION_USE
        depends on USE_DIRECT_IS_CONTROL
        default n
        help
          Use device companion direct control.
 config COMPANION_C2_DIRECT_USE
        bool "Use direct control for companion C2"
        depends on VENDER_MCD_LEGACY
        depends on COMPANION_C2_USE
        depends on COMPANION_DIRECT_USE
        default n
        help
          Use device companion C2.
 config COMPANION_C3_DIRECT_USE
        bool "Use direct control for companion C3"
        depends on VENDER_MCD_LEGACY
        depends on COMPANION_C3_USE
        depends on COMPANION_DIRECT_USE
        default n
        help
          Use device companion C3.
config COMPANION_DCDC_USE
        bool "Use companion DCDC regulator"
        depends on VENDER_MCD_LEGACY
        default n
        help
          Use companion DCDC regulator.
config PREPROCESSOR_STANDBY_USE
        bool "Use companion standby"
        depends on VENDER_MCD_LEGACY
        default n
        help
          Use companion standby.
config SENSOR_RETENTION_USE
	bool "Use sensor retention"
	depends on VENDER_MCD_LEGACY
	default n
	help
	  Use sensor retention.
config OIS_USE
        bool "Use ois"
        depends on VENDER_MCD_LEGACY
        default n
        help
          Use ois.
config OIS_FW_UPDATE_THREAD_USE
        bool "Enable ois fw update thread"
        depends on OIS_USE
        default n
        help
          Enable ois fw update thread.
config AF_HOST_CONTROL
        bool "Enable host af control"
        depends on VENDER_MCD_LEGACY
        default n
        help
          Enable host af control.
config TORCH_CURRENT_CHANGE_SUPPORT
        bool "Change torch current in recording mode"
        depends on VENDER_MCD_LEGACY
        default n
        help
          Change torch current in recording mode.
config OIS_USE_RUMBA_S4
        bool "Use RUMBA S4 ois driver IC"
        depends on OIS_USE
        default n
        help
          Use RUMBA S4 ois driver IC.
config CAMERA_JACKPOT
        bool "This camera is jackpot project"
        depends on VENDER_MCD_LEGACY
        default n
        help
          This camera is jackpot project.
config CAMERA_J3TOPE
        bool "This camera is j3tope project"
        depends on VENDER_MCD_LEGACY
        default n
        help
          This camera is j3tope project.
config CAMERA_J7TOPE
        bool "This camera is j7tope project"
        depends on VENDER_MCD_LEGACY
        default n
        help
          This camera is j7tope project.
config CAMERA_J7DUO
        bool "This camera is j7duo project"
        depends on VENDER_MCD_LEGACY
        default n
        help
          This camera is j7duo project.
config CAMERA_JACKPOT_JPN
        bool "This camera is jackpotjpn project"
        depends on VENDER_MCD_LEGACY
        default n
        help
          This camera is jackpotjpn project.
config CAMERA_GVIEW2
        bool "This camera is gview2 project"
        depends on VENDER_MCD_LEGACY
        default n
        help
          This camera is gview2 project.
config CAMERA_A6E
        bool "This camera is a6e project"
        depends on VENDER_MCD_LEGACY
        default n
        help
          This camera is a6e project.
config CAMERA_A7Y18
        bool "This camera is a7y18 project"
        depends on VENDER_MCD_LEGACY
        default n
        help
          This camera is a7y18 project.
config CAMERA_J2CORE
        bool "This camera is j2core project"
        depends on VENDER_MCD_LEGACY
        default n
        help
          This camera is j2core project.
config CAMERA_M20
        bool "This camera is M20 project"
        depends on VENDER_MCD_LEGACY
        default n
        help
          This camera is M20 project.
config CAMERA_M30
        bool "This camera is M30 project"
        depends on VENDER_MCD_LEGACY
        default n
        help
          This camera is M30 project.
config CAMERA_OTPROM_SUPPORT_FRONT
        bool "This camera is otp front project"
        depends on VENDER_MCD_LEGACY
        default n
        help
          This camera is otp front project.
config CAMERA_OTPROM_SUPPORT_REAR
        bool "This camera is otp rear project"
        depends on VENDER_MCD_LEGACY
        default n
        help
          This camera is otp rear project.
```

## drivers/media/radio/s610/Kconfig
```kconfig
#
# SAMSUNG's S610 FM driver based on SPEEDY driver.
#
menu "Samsung S610 FM driver (SPEEDY based)"
config RADIO_S610
	tristate "Samsung S610 FM Radio"
	depends on VIDEO_V4L2 && RADIO_S5E7885
	help
	Choose Y here if you have this FM radio chip.

config RADIO_S610_AOSP_FWK
	bool "Samsung S610 RM Radio AOSP Framework support"
	depends on RADIO_S610
	default y
	help
          Enables support for the extra interfaces used by Eureka ROM's FMRadio
endmenu
```
