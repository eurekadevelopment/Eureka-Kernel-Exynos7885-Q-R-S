/*
 * SAMSUNG EXYNOS device tree source for reserved-memory
 *
 * Copyright (c) 2015 Samsung Electronics Co., Ltd.
 *		http://www.samsung.com
 *
 * This program is free software; you can redistribute it and/or modify
 * it under the terms of the GNU General Public License version 2 as
 * published by the Free Software Foundation.
*/


&reserved_memory {
	#address-cells = <2>;
	#size-cells = <1>;

	abox_rmem: abox_rmem@0xE9400000 {
		compatible = "exynos,abox_rmem";
		reg = <0x0 0xE9400000 0x400000>;
	};
};
