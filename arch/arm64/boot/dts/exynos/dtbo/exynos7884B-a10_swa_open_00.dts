/*
 * SAMSUNG EXYNOS7884B board device tree source

 *
 * Copyright (c) 2018 Samsung Electronics Co., Ltd.
 *		http://www.samsung.com
 *
 * This program is free software; you can redistribute it and/or modify
 * it under the terms of the GNU General Public License version 2 as
 * published by the Free Software Foundation.
*/

/dts-v1/;
/plugin/;

#include "exynos7884B-a10_common.dtsi"
#include "exynos7884B-a10_swa_open_gpio_00.dtsi"
/ {
	compatible = "samsung,A10 SWA OPEN 00", "samsung,EXYNOS7884B";

	dtbo-hw_rev = <0>;
    dtbo-hw_rev_end = <255>;


	fragment@model {
		target-path = "/";
		__overlay__ {
			#address-cells = <2>;
			#size-cells = <1>;

			model = "Samsung A10 SWA OPEN 00 - Eureka Exynos7885 R9.5";

		}; /* end of __overlay__ */
	}; /* end of fragment */
}; /* end of root */

&hsi2c_5 {
	touchscreen@48 {
		status = "okay";
	};
};