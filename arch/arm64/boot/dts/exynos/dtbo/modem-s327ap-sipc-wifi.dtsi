/*
 * SAMSUNG UNIVERSAL7885 board device tree source
 *
 * Copyright (c) 2016 Samsung Electronics Co., Ltd.
 *             http://www.samsung.com
 *
 * This program is free software; you can redistribute it and/or modify
 * it under the terms of the GNU General Public License version 2 as
 * published by the Free Software Foundation.
*/

&reserved_memory {
	#address-cells = <2>;
	#size-cells = <1>;
	modem_if {
			status = "disabled";
	};

	cp_ram_logging {
			status = "disabled";
	};
};