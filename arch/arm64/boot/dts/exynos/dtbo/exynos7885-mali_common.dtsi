/*
 * SAMSUNG EXYNOS7885 SoC device tree source
 *
 * Copyright (c) 2018 Samsung Electronics Co., Ltd.
 *		http://www.samsung.com
 *
 * This program is free software; you can redistribute it and/or modify
 * it under the terms of the GNU General Public License version 2 as
 * published by the Free Software Foundation.
*/

/ {
	mali: mali@11500000 {
		compatible = "arm,mali";
		reg = <0x0 0x11500000 0x5000>;
		interrupts = <0 159 0>,
		             <0 160 0>,
		             <0 158 0>;
		interrupt-names = "JOB", "MMU", "GPU";
		g3d_cmu_cal_id = <ACPM_DVFS_G3D>;
		samsung,power-domain = <&pd_g3d>;
		g3d_genpd_name = "pd-g3d"; /*KC: pg-g3d, LT,MK: pd-embedded_g3d*/
		#cooling-cells = <2>; /* min followed by max */
		governor = "interactive";
		gpu_sustainable_info = <0 0 0 0 0>; /* Not used */
		gpu_pmqos_cpu_cluster_num = <2>;
		gpu_pmu_status_reg_offset = <0x40A4>;
		gpu_pmu_status_local_pwr_mask = <0xF>; /*0xF << 0*/
		gpu_min_clock = <343000>;
		gpu_dvfs_start_clock = <343000>;
		gpu_dvfs_bl_config_clock = <343000>;
		gpu_default_voltage = <800000>;
		gpu_cold_minimum_vol = <0>;
		gpu_voltage_offset_margin = <37500>;
		gpu_tmu_control = <1>;
		gpu_power_coeff = <625>;
		gpu_dvfs_time_interval = <5>; /*1 tick : 10ms*/
		gpu_default_wakeup_lock = <1>;
		gpu_dynamic_abb = <0>;
		gpu_early_clk_gating = <0>;
		gpu_dvs = <0>;
		gpu_inter_frame_pm = <0>;
		gpu_perf_gathering = <0>;
		gpu_runtime_pm_delay_time = <50>;
		gpu_dvfs_polling_time = <30>;
		gpu_pmqos_int_disable = <0>;
		gpu_pmqos_mif_max_clock = <1794000>;
		gpu_pmqos_mif_max_clock_base = <545000>;
		gpu_cl_dvfs_start_base = <343000>;
		gpu_debug_level = <3>; /*DEBUG(1) INFO(2) WARNING(3) ERROR(4)*/
		gpu_trace_level = <8>; /*TRACE_ALL*/
		gpu_mo_min_clock = <676000>;
		gpu_boost_gpu_min_lock = <0>;
		gpu_boost_egl_min_lock = <1248000>;
		//gpu_vk_boost_max_lock = <338000>;
		//gpu_vk_boost_mif_min_lock = <1794000>;
		gpu_bts_support = <0>;
		gpu_asv_cali_lock_val = <0>; /*Should check this value when MALI_ASV_CALIBRATION_SUPPORT is enabled*/
		gpu_set_pmu_duration_reg = <0>; /* only for KC for now*/
		gpu_set_pmu_duration_val = <0>; /* only for KC for now*/
	};
};
