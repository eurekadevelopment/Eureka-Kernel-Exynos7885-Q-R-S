/*
 * SAMSUNG EXYNOS7884B SoC device tree source
 *
 * Copyright (c) 2018 Samsung Electronics Co., Ltd.
 *		http://www.samsung.com
 *
 * This program is free software; you can redistribute it and/or modify
 * it under the terms of the GNU General Public License version 2 as
 * published by the Free Software Foundation.
*/

&mali {
	interactive_info = <1001000 75 0>;
	gpu_dvfs_table_size = <9 7>; /*<row col>*/
	                /* clk     min max  down mif_min  lit_min big_max */
	gpu_dvfs_table = < 1300000 97   99  1    1794000   0 0
	                   1200000 90   95  1    1794000   0 0
	                   1100000 90   95  1    1794000   0 0
	                   1001000 90   95  1    1794000   0 0
	                    845000 90   95  1    1352000   0 0
	                    676000 90   95  1    1352000   0 0
	                    545000 90   95  1     676000   0 0
	                    450000 85   95  1     546000   0 0
	                    343000 70   90  1     420000   0 0 >;
	gpu_min_clock_limit = <343000>;
	gpu_max_clock = <1300000>;
	gpu_max_clock_limit = <1300000>;
	gpu_temp_throttling_level_num = <6>;
	gpu_temp_throttling = <1300000 1300000 1200000 845000 676000 450000>;
};
